/* Alternate keymap variant for the Cradio -- selected via `keymap: cradio_alt` in build.yaml */

/* source keypos definitions */
#include <zmk-helpers/key-labels/34.h>

/* activate bluetooth */
#define CONFIG_WIRELESS 1

/* source the variant keymap */
#include "alt.keymap"
